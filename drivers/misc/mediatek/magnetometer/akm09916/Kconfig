## drivers/misc/mediatek/magnetometer/akm09916/Kconfig
```kconfig
config MTK_AKM09916
	tristate "AKM09911 for MediaTek package"
	default n
	help
	  It support different magnetometer sensor.
          If this option is set,
	  it will support
          AKMD09916 magnetometer.
```
